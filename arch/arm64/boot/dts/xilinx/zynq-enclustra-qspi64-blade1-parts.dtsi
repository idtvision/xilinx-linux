&qspi {
        status = "okay";
        is-dual = <0>;
        num-cs = <1>;
        flash@0 {
                compatible = "s25fl512s";
                reg = <0x0>;
                spi-tx-bus-width = <1>;
                spi-rx-bus-width = <4>;
                spi-max-frequency = <50000000>;
                #address-cells = <1>;
                #size-cells = <1>;
                partition@qspi-boot-bin {
                        label = "qspi-bootimage";
                        reg = <0x0 0x2000000>;
                };
                partition@qspi-the-rest {
                        label = "qspi-kernel";
                        reg = <0x2000000 0x2000000>;
                };
        };
};
